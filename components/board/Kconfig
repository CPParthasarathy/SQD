## components/board/Kconfig
```kconfig
menu "SQD board support"

config SQD_BOARD_HELTEC_WIFI_LORA_32_V3_2
    bool "Heltec WiFi LoRa 32 V3.2 HTIT-WB32LAF"
    default n
    help
        Select the exact Heltec WiFi LoRa 32 V3.2
        HTIT-WB32LAF board mapping.

        This option has no implicit default. The board component
        CMake contract fails the build unless exactly one
        controlled SQD board selection is enabled.

endmenu
```

## sdkconfig.defaults
```kconfig
# B3.1 common platform configuration.
# Controlled hardware invariants shared by all build profiles.
CONFIG_IDF_TARGET="esp32s3"
CONFIG_ESPTOOLPY_FLASHSIZE_8MB=y
CONFIG_ESPTOOLPY_FLASHSIZE="8MB"
# C2.2 controlled board selection.
CONFIG_SQD_BOARD_HELTEC_WIFI_LORA_32_V3_2=y
# B3.3 reproducible-build controls.
CONFIG_APP_REPRODUCIBLE_BUILD=y
# CONFIG_APP_COMPILE_TIME_DATE is not set
# CONFIG_BOOTLOADER_COMPILE_TIME_DATE is not set
```
